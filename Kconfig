## drivers/Kconfig
```kconfig
# SPDX-License-Identifier: GPL-2.0-only

menu "drivers"

menu "device naming policy"

config SERIAL_NAME_PREFIX
    string "Serial device name prefix"
    default "ttyS"
    help
      The base name for serial UART devices. For example, "ttyS" results in "ttyS0", "ttyS1", etc.
      Change this if your target FHS prefers different naming (e.g. "com", "uart").

config PTY_SLAVE_PREFIX
    string "PTY slave device name prefix"
    default "pts"
    help
      The base name for pseudo-terminal slave devices (e.g. "pts", "pty").
      This will be used for nodes in devfs.

config FB_NAME_PREFIX
    string "Framebuffer device name prefix"
    default "fb"
    help
      The base name for framebuffer devices. For example, "fb" results in "fb0", "fb1", etc.

config IDE_NAME_PREFIX
    string "IDE/PATA block device name prefix"
    default "hd"
    help
      The base name for legacy IDE/PATA disks. Default is "hd" (e.g., "hda", "hdb" or "hd0").

config CDROM_NAME_PREFIX
    string "ATAPI/CDROM block device name prefix"
    default "cdrom"
    help
      The base name for ATAPI CD/DVD-ROM devices.

config SATA_NAME_PREFIX
    string "SATA/SCSI block device name prefix"
    default "sd"
    help
      The base name for SATA, SCSI, or VirtIO disks. Default is "sd" (e.g., "sda", "sdb" or "sd0").

config NVME_NAME_PREFIX
    string "NVMe block device name prefix"
    default "nvme"
    help
      The base name for NVMe storage devices (e.g., "nvme0").

config IC_NAME_PREFIX
    string "Interrupt Controller name prefix"
    default "ic"
    help
      The base name for interrupt controllers (e.g., "ic0").

config TIME_NAME_PREFIX
    string "Time Source name prefix"
    default "timer"
    help
      The base name for time sources (e.g., "timer0").

config PCI_NAME_PREFIX
    string "PCI device name prefix"
    default "pci"
    help
      The prefix for PCI devices. If empty, the bus address format is used directly.

config ACPI_NAME_PREFIX
    string "ACPI device name prefix"
    default "acpi"
    help
      The prefix for ACPI devices discovered in the namespace.

endmenu

config LOG_DEVICE_TREE
    bool "Log device tree on boot"
    default y
    help
      If enabled, the kernel will print the entire unified device tree
      at the end of the initialization process.

source "drivers/acpi/Kconfig"
source "drivers/block/Kconfig"
source "drivers/graphics/Kconfig"
source "drivers/iommu/Kconfig"
source "drivers/uart/Kconfig"
source "drivers/fw/Kconfig"

endmenu
```

## drivers/acpi/Kconfig
```kconfig
# SPDX-License-Identifier: GPL-2.0-only

menu "acpi"

config ACPI_POWER_KERNEL_DEINITIALIZE
    bool "Enable shutdown sequence"
    default n
    help
      Enables graceful shutdown and rollbacks

config ACPI_DEBUG_OUTPUT
    bool "Enable debug output"
    default n
    help
      Make ACPICA more talkative

config ACPI_OSI_HANDLER
    bool "Enable custom OSI handler"
    default n
    help
      Install custom ACPICA OSI handler

config DENY_LINUX_OSI
    bool "Deny Linux OSI"
    default y
    depends on ACPI_OSI_HANDLER
    help
      Deny Linux support in OSI handler
      making firmwares behaves 'better'

endmenu
```

## drivers/block/Kconfig
```kconfig
# SPDX-License-Identifier: GPL-2.0-only

menu "block"

config BLOCK_PARTITION
    bool "Enable support for partitions"
    default y
    help
      Enable partitions support for block devices

config EXT_IDE_ATA
    bool "Enable support for IDE/ATA drives"
    default y
    help
      Compiles driver for IDE/ATA block storage

endmenu
```

## drivers/fw/Kconfig
```kconfig
# SPDX-License-Identifier: GPL-2.0-only

menu "fw"

config EXT_RT_FW_SUPPORT
    bool "Enable support for SMBIOS, NVRAM and EFI runtime services module"
    default y
    help
      Compiles module for SMBIOS, NVRAM and EFI runtime support

endmenu
```

## drivers/graphics/Kconfig
```kconfig
# SPDX-License-Identifier: GPL-2.0-only

menu "graphics"

source "drivers/graphics/drm/Kconfig"

config FB_REQUEST
    bool "Request for a linear framebuffer"
    default y
    help
      Requests a simple linear framebuffer for DRM

endmenu
```

## drivers/graphics/drm/Kconfig
```kconfig
# SPDX-License-Identifier: GPL-2.0-only

menu "drm"

config EXT_DRM_RENDERER
    bool "Enable a DRM renderer"
    depends on FB_REQUEST
    default y
    help
      Requests a simple linear framebuffer for simple rendering

config DRM_LINEARFB_COLOR
    bool "Enable ANSI color support for linearfb console"
    depends on EXT_DRM_RENDERER
    default y
    help
      Enables parsing of ANSI color escape sequences in the linearfb
      console driver.

endmenu
```

## drivers/iommu/Kconfig
```kconfig
# SPDX-License-Identifier: GPL-2.0-only

menu "iommu support"

config EXT_INTEL_IOMMU
    bool "Intel VT-d IOMMU support"
    depends on IOMMU_SUPPORT
    default y
    help
      Enable support for Intel VT-d (Virtualization Technology for Directed I/O).

endmenu
```

## drivers/uart/Kconfig
```kconfig
# SPDX-License-Identifier: GPL-2.0-only

menu "uart"

config EXT_UART
    bool "Enable support for uart driver"
    default y
    help
      Builds a uart driver module

endmenu
```

## fs/Kconfig
```kconfig
# SPDX-License-Identifier: GPL-2.0-only

menu "fs"

config VFS
    bool "Virtual File System (VFS) support"
    default y
    help
      Enable support for the Virtual File System layer.

config VFS_PURE_KERNEL
    bool "VFS Pure Kernel Mode (Disable all auto-mounts)"
    depends on VFS
    default n
    help
      If enabled, the kernel will not perform any automatic mounts of
      pseudo-filesystems (devtmpfs, procfs, sysfs, resfs).
      This ensures the kernel makes zero assumptions about the
      userspace filesystem layout. Policy becomes the absolute
      responsibility of the init process.

config VFS_UBC
    bool "Unified Buffer Cache (UBC)"
    depends on VFS
    default y
    help
      Enable the Unified Buffer Cache. This ensures that the VFS and
      Memory Management layers share the same physical pages for file
      data. All buffered I/O goes through the Page Cache.

config VFS_RESCONTROL
    bool "Resource Domain Control (ResDomain) VFS integration"
    depends on VFS && RESDOMAINS
    default y
    help
      Integrate Hierarchical Resource Domains (ResDomain) with the VFS.
      This allows associating filesystems or mount points with specific
      resource limits and accounting.

config VFS_DEBUG_EVENTS
    bool "VFS Event Debugging"
    depends on VFS
    default n
    help
      Enable verbose logging of VFS events (create, delete, modify).

config VFS_RENAME_OVERWRITE
    bool "VFS rename overwrites destination"
    depends on VFS
    default y
    help
      If enabled, the rename() system call will overwrite the destination
      if it exists and is of the same type (file or directory). This is
      the default POSIX and Linux behavior.

config AEROQ_HFS
    bool "AeroQ Hierarchical File System (HFS) layout"
    depends on VFS
    default y
    help
      Enable the AeroQ HFS layout. This sets the default mount paths
      for pseudo-filesystems like devtmpfs, procfs, and sysfs to comply
      with the AeroQ OS specification.

      Paths:
        - devtmpfs: /runtime/devices
        - procfs: /runtime/processes
        - sysfs: /runtime/sys
        - resfs: /runtime/res

config VFS_DCACHE_SIZE
    int "Dentry Cache Size"
    depends on VFS
    default 4096
    help
      The maximum number of directory entries to cache in memory.
      Higher values speed up path lookup but consume more slab memory.

config DEVTMPFS
    bool "Device Temporary Filesystem (devtmpfs) support"
    depends on VFS
    default y
    help
      Enable support for devtmpfs, a kernel-managed pseudo-filesystem
      for device nodes.

config DEVTMPFS_MOUNT
    bool "Mount devtmpfs automatically during boot"
    depends on DEVTMPFS && !VFS_PURE_KERNEL
    default y
    help
      Automatically mount devtmpfs during kernel initialization.

config DEVTMPFS_MOUNT_PATH
    string "Default mount path for devtmpfs"
    depends on DEVTMPFS_MOUNT
    default "/runtime/devices" if AEROQ_HFS
    default "/dev"
    help
      The path where devtmpfs should be mounted automatically.

config PROCFS
    bool "Process Information Filesystem (procfs) support"
    depends on VFS
    default y
    help
      Enable support for procfs, a pseudo-filesystem for process
      information and system statistics.

config PROCFS_MOUNT
    bool "Mount procfs automatically during boot"
    depends on PROCFS && !VFS_PURE_KERNEL
    default y
    help
      Automatically mount procfs during kernel initialization.

config PROCFS_MOUNT_PATH
    string "Default mount path for procfs"
    depends on PROCFS_MOUNT
    default "/runtime/processes" if AEROQ_HFS
    default "/proc"
    help
      The path where procfs should be mounted automatically.

config SYSFS
    bool "System Filesystem (sysfs) support"
    depends on VFS
    default y
    help
      Enable support for sysfs, a pseudo-filesystem for kernel objects.

config SYSFS_MOUNT
    bool "Mount sysfs automatically during boot"
    depends on SYSFS && !VFS_PURE_KERNEL
    default y
    help
      Automatically mount sysfs during kernel initialization.

config SYSFS_MOUNT_PATH
    string "Default mount path for sysfs"
    depends on SYSFS_MOUNT
    default "/runtime/sys" if AEROQ_HFS
    default "/sys"
    help
      The path where sysfs should be mounted automatically.

config RESFS
    bool "Resource Domain Filesystem (resfs) support"
    depends on VFS && RESDOMAINS
    default y
    help
      Enable support for resfs, a pseudo-filesystem for managing
      hierarchical resource domains.

config RESFS_MOUNT
    bool "Mount resfs automatically during boot"
    depends on RESFS && !VFS_PURE_KERNEL
    default y
    help
      Automatically mount resfs during kernel initialization.

config RESFS_MOUNT_PATH
    string "Default mount path for resfs"
    depends on RESFS_MOUNT
    default "/runtime/res" if AEROQ_HFS
    default "/res"
    help
      The path where resfs should be mounted automatically.

config USTARFS
    bool "USTAR (tar) filesystem support"
    depends on VFS
    default y
    help
      Enable support for the USTAR filesystem.

config INITRAMFS
    bool "Initramfs (CPIO) support"
    depends on VFS
    default y
    help
      Enable support for unpacking a CPIO archive into the rootfs.

config INITRD_NAME_MAX_SIZE
    int "Maximum name size for initramfs image"
    depends on INITRAMFS
    default 128
    help
      Maximum length for initramfs name passed in initrd= in cmdline

endmenu
```

## kconfig/compatability/Kconfig
```kconfig
# SPDX-License-Identifier: GPL-2.0-only

menu "compatability"

config SPINLOCK_LINUX_COMPAT
    bool "Enable common Linux macros/methods for spinlock"
    default y
    help
      Enables Linux-style spinlock definitions

config ATOMIC_LINUX_COMPAT
    bool "Enable common Linux atomic-related macros/methods"
    default y
    help
      Enables Linux-style atomic operations

config BOCHS_COMPAT
    bool "Bochs emulator compatibility mode"
    default n
    help
      Enable compatibility mode for Bochs x86 emulator.
      Disables SSE/SSE2/SSE3+ instruction generation and runtime
      CPU feature enablement that Bochs cannot properly emulate.
      
      Only enable this when building specifically for Bochs testing.
      This will reduce performance on real hardware.

endmenu
```

## kconfig/miscellaneous/Kconfig
```kconfig
# SPDX-License-Identifier: GPL-2.0-only

menu "miscellaneous"

config INCLUDE_MM_TESTS
    bool "Include memory tests"
    default y
    help
      Include memory-related stress tests (only enable on verbose boot)

config ACPI_POWER_BUTTON
    bool "Enable and configure power button"
    default y
    help
      Enables support for power button through uACPI

config ACPI_SLEEP_BUTTON
    bool "Enable and configure sleep button"
    default y
    help
      Enables support for sleep button through uACPI

config INCLUDE_DEPRECATED_CODE
    bool "Include deprecated code"
    default n
    help
      Include deprecated code for compilation,
      may result in various warnings

config IMPLICIT_FD12_STDOUT_STDERR
    bool "Enable implicit paths for FD1/2 on write()"
    default n
    help
      Enables implicit path for FD1/2 on write()
      e.g., writing to a specific device

choice
    prompt "FD1/2 actions"
    default IMPLICIT_FD12_STDOUT_STDERR_PRINTK
    depends on IMPLICIT_FD12_STDOUT_STDERR
    help
      Select the behaviour of write() to FD1/2

config IMPLICIT_FD12_STDOUT_STDERR_PRINTK
    bool "Redirect FD1/2 to printk on write()"
    help
      Redirect write() with FD1/2 to printk

endchoice

endmenu
```

## lib/Kconfig
```kconfig
# SPDX-License-Identifier: GPL-2.0-only

menu "lib"

config LIST_HARDENED
    bool "Enable hardened linked-list"
    default n

config DEBUG_PLIST
    bool "Enabled debug plist (priority lists)"
    default n

config INTERVAL_TREE_SPAN_ITER
    bool "Enable interval tree span interation"
    default y

config QUEUE_MACRO_DEBUG_ASSERTIONS
    bool "Enable bsd queue assertions"
    default n

config OPTIMIZED_STRING
    bool "Enable optimized string functions"
    default y
    help
      Use architecture-specific (x86_64) optimized implementations for
      string and memory functions (memcpy, memset, etc.) using ERMS/FSRM.

config LIBC_STRING_FULL
    bool "Enable full suite of C string functions"
    default y
    help
      Include the complete set of C standard string functions (strtok,
      strcspn, etc.) in the kernel.

config KSTRTO_ERRORS
    bool "Enable detailed kstrto* error reporting"
    default y
    help
      Enable detailed error codes (EINVAL, ERANGE) for kernel string-to-number
      conversion functions.

config STRING_FLOAT
    bool "Enable floating-point string conversions"
    default y
    help
      Include strtod, strtof and floating-point conversion functions.
      Increases kernel size significantly.

config STRING_PATTERN
    bool "Enable pattern matching functions"
    default y
    help
      Include fnmatch, glob-style pattern matching for filesystem operations.

config STRING_ADVANCED
    bool "Enable advanced memory functions"
    default y
    help
      Include memrchr, memmem, memswap and other advanced memory operations.

config STRING_CRYPTO
    bool "Enable cryptographic string functions"
    default y
    help
      Include constant-time comparison and crypto-safe string functions.

config PRINTK_COLOR
    bool "Enable ANSI color support for printk"
    default y
    help
      Enables support for ANSI color escape sequences in printk output.

endmenu
```
