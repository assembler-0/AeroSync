## Kconfig
```kconfig
# SPDX-License-Identifier: GPL-2.0-only
# AeroSync root Kconfig script

mainmenu "AeroSync system configuration"

source "arch/Kconfig"
source "drivers/Kconfig"
source "fs/Kconfig"
source "lib/Kconfig"
source "mm/Kconfig"
source "crypto/Kconfig"
source "aerosync/Kconfig"
source "aerosync/sched/Kconfig"
source "kconfig/compatability/Kconfig"
source "kconfig/miscellaneous/Kconfig"
```

## aerosync/Kconfig
```kconfig
# SPDX-License-Identifier: GPL-2.0-only

menu "system"

config ASYNC_PRINTK
    bool "Enable asynchronous printk"
    default y
    help
      Enables high-performance asynchronous logging
      framework for printk

config KDB
    bool "Enable support for KDB (Kenrel DeBugger)"
    default y
    help
      Call kdb function after panic, effiectively handling
      kernel control to KDB

menu "synchronization"

config TICKET_SPINLOCKS
    bool "Ticket Spinlocks"
    default y
    help
      Use fair ticket-based spinlocks instead of simple test-and-set locks.
      This ensures FIFO order and prevents CPU starvation under contention.

config MCS_SPINLOCKS
    bool "MCS Spinlocks"
    default y
    help
      Enable support for MCS (Mellor-Crummey and Scott) locks.
      MCS locks are highly scalable and perform well under high contention
      by having each CPU spin on its own local variable.

config DEBUG_SPINLOCK
    bool "Spinlock debugging"
    default n
    help
      Enable extra checks and debugging information for spinlocks,
      including owner tracking and deadlock detection.

menu "rcu subsystem"

config TREE_RCU
    bool "Tree-based RCU (Scalable SMP RCU)"
    default y if MAX_CPUS > 1
    help
      This option selects a hierarchical RCU implementation that is
      scalable for systems with many CPUs.

config TINY_RCU
    bool "Tiny RCU (Non-preemptible single-CPU RCU)"
    default n
    depends on MAX_CPUS = 1
    help
      This option selects a very small RCU implementation for
      single-CPU systems.

config RCU_FANOUT
    int "Tree-based RCU leaf-level fanout"
    depends on TREE_RCU
    default 16
    help
      This option controls the number of CPUs per leaf rcu_node.
      Smaller values increase tree depth and lock contention for
      reporting quiescent states, while larger values increase
      lock contention on the leaf nodes themselves.

config RCU_BOOST
    bool "Enable RCU priority boosting"
    depends on TREE_RCU
    default y
    help
      This option enables RCU priority boosting, which allows
      low-priority RCU read-side critical sections to be
      preempted and then boosted to a higher priority to avoid
      holding up grace periods.

config RCU_KTHREAD_PRIO
    int "RCU kthread priority"
    depends on TREE_RCU
    default 1
    help
      Set the priority of the RCU kthreads.

config SRCU
    bool "Sleepable Read-Copy-Update (SRCU)"
    default y
    help
      This option enables Sleepable RCU, which allows readers to sleep
      within their read-side critical sections.

config RCU_PERCPU_TEST
    bool "Enable RCU and Per-CPU dynamic allocation tests"
    default n
    help
      Enables RCU and Per-CPU dynamic allocation smoke tests during boot.

endmenu # rcu subsystem

endmenu # synchronization

menu "per-cpu subsystem"

config DYNAMIC_PER_CPU
    bool "Support for dynamic per-CPU allocation"
    default y
    help
      Enables alloc_percpu() and free_percpu() APIs for allocating
      per-CPU variables at runtime.

config PER_CPU_CHUNK_SIZE
    int "Size of each dynamic per-CPU chunk (KB)"
    depends on DYNAMIC_PER_CPU
    default 64
    help
      Determines the size of each chunk used for dynamic per-CPU
      allocations. Each CPU will have this much space reserved.

endmenu

menu "panic"

config PANIC_STACKTRACE
    bool "Enable stacktrace on panic"
    default y
    help
      Enables kernel stack unwinding and symbol resolution when a
      kernel panic occurs.


config PANIC_DUMP_REGISTERS
    bool "Always dump registers on panic"
    default y
    help
      Dump CPU general purpose and control registers on all panics,
      not just exceptions.

config PANIC_TIMEOUT
    int "Panic timeout (seconds)"
    default -1
    help
      Number of seconds to wait before rebooting after a panic.
      Set to -1 to wait indefinitely, or 0 to reboot immediately.

config PANIC_VERBOSE
    bool "Verbose panic messages"
    default y
    help
      Display extra information like CPU ID, current task name,
      and kernel version on panic.

endmenu

menu "cmdline"

config COMMAND_LINE_SIZE
    int "Command line buffer size"
    default 4096
    help
      Maximum size of the command line string that can be parsed.

endmenu

menu "system fusion"

config FUSION_UBC
    bool "Unified Buffer Cache (UBC)"
    default y
    help
      Enables full fusion between the page cache (VM objects) and
      the VFS layer. mmap, read, and write will share the same pages.

config FUSION_RESDOMAIN_MM
    bool "ResDomain Memory Accounting"
    depends on RESDOMAIN_MEM
    default y
    help
      Enables automatic memory accounting in the VM system using
      Resource Domains. Memory mapped or allocated via mmap will
      be charged to the process's domain.

config FUSION_BLOCKING_IO
    bool "Unified Blocking I/O"
    default y
    help
      Integrates VFS wait queues with the scheduler for efficient
      blocking I/O operations.

config FUSION_POSIX_SYSCALLS
    bool "Enhanced POSIX Syscall Layer"
    default y
    help
      Enables a more comprehensive and compliant POSIX system call
      layer, including advanced FD management and signals.

endmenu

source "aerosync/sysintf/Kconfig"

menu "module management"

config LIMINE_MODULE_MANAGER
    bool "Enable Limine Module Manager (LMM)"
    default y
    help
      Enable the centralized Limine Module Manager to manage and probe
      bootloader-provided modules.

config LMM_PROBE_EXTENSION_FIRST
    bool "Biased probing: check file extensions first"
    depends on LIMINE_MODULE_MANAGER
    default y
    help
      If enabled, the LMM will check file extensions before running
      registered probers. This can speed up boot if many modules are present.

config LMM_SORT_BY_PRIORITY
    bool "Enable priority-based module sorting"
    depends on LIMINE_MODULE_MANAGER
    default n
    help
      Enable sorting modules by priority before processing.

endmenu

menu "resource management"

config RESDOMAINS
    bool "Hierarchical Resource Domains (ResDomains)"
    default y
    help
      Enables grouping of processes into hierarchical domains for
      resource accounting and control (similar to cgroup v2).

config RESDOMAIN_CPU
    bool "CPU Controller"
    depends on RESDOMAINS
    default y
    help
      Provides CPU bandwidth and weight control for domains.

config RESDOMAIN_MEM
    bool "Memory Controller"
    depends on RESDOMAINS
    default y
    help
      Provides memory limits and accounting for domains.

config RESFS_MOUNT
    bool "Mount resfs automatically during boot"
    depends on RESDOMAINS
    default y
    help
      Automatically mount the resource filesystem (resfs) during boot.

config RESFS_MOUNT_PATH
    string "Default mount path for resfs"
    depends on RESFS_MOUNT
    default "/runtime/res"
    help
      The path where resfs should be mounted automatically.

endmenu

endmenu
```

## aerosync/sched/Kconfig
```kconfig
# SPDX-License-Identifier: GPL-2.0-only

menu "scheduler"

config SCHED_SMT
    bool "SMT (Hyperthreading) scheduler support"
    default y
    help
      Improve the scheduler's decision making when dealing with SMT (Simultaneous
      Multi-Threading) siblings. This ensures that the scheduler avoids
      scheduling multiple tasks on the same physical core if other cores are
      completely idle.

config SCHED_MC
    bool "Multi-core scheduler support"
    default y
    help
      Enable Multi-core (MC) domain scheduling. This helps the scheduler
      understand cache sharing (LLC) between cores, allowing for better
      locality-aware task placement.

config SCHED_HYBRID
    bool "Hybrid (P/E core) scheduler support"
    default y
    help
      Enable support for Intel Hybrid architectures (e.g. Alder Lake, Raptor Lake).
      The scheduler will distinguish between Performance (P) cores and Efficiency (E)
      cores, preferring P-cores for compute-intensive tasks and E-cores for
      background tasks.


config SCHED_LOAD_TRACKING_PELT
    bool "PELT (Per-Entity Load Tracking)"
    default y
    help
      Use Linux-like PELT for tracking task and runqueue load.

config SCHED_AUTO_BALANCE
    bool "Automatic scheduler load balancing"
    default n
    help
      Enable dynamic load balancing and tasks migration across CPUs

config SCHED_TICK_STAGGER
    bool "Stagger periodic scheduler tasks"
    depends on SCHED_AUTO_BALANCE
    default y
    help
      Stagger periodic tasks like load balancing across CPUs to avoid
      synchronized lock contention.

config SCHED_LB_PERIOD_MS
    int "Load balancing period (ms)"
    depends on SCHED_AUTO_BALANCE
    default 100
    help
      Interval between periodic load balancing attempts.

config UNSAFE_USER_TASK_SPAWN
    bool "Enable spawn_user_process_raw()"
    depends on INCLUDE_DEPRECATED_CODE
    default n
    help
      Export the spawn_user_process_raw() API for use
      A deprecated, internal-only unsafe function that spawns
      a user process from a buffer

endmenu
```

## aerosync/sysintf/Kconfig
```kconfig
# SPDX-License-Identifier: GPL-2.0-only

menu "unified driver model (udm) & system interfaces"

config UDM_CORE
    bool "Unified Driver Model (UDM) Core"
    default y
    help
      The core infrastructure for device, driver, bus, and class
      management. This is the foundation of the AeroSync hardware
      abstraction layer.

config SYSINTF
    bool "Legacy System Interface Compatibility"
    select UDM_CORE
    default y
    help
      Enables the unified subsystem APIs (Block, PCI, TTY, etc.) 
      that were formerly part of the standalone sysintf layer.
      These are now natively integrated into UDM.

config UDM_BLOCK
    bool "Block Device Subsystem"
    depends on UDM_CORE
    default y
    help
      Enable support for block devices (disks, partitions).
      Provides the unified block_read/write/flush API.

config UDM_CHAR
    bool "Character Device Subsystem"
    depends on UDM_CORE
    default y
    help
      Enable support for character devices (terminals, serial, etc.).

config UDM_PCI
    bool "PCI Bus Support"
    depends on UDM_CORE
    default y
    help
      Enable UDM support for the PCI bus, including dynamic
      config space access provider selection.

config UDM_ACPI
    bool "ACPI Device Support"
    depends on UDM_CORE
    default y
    help
      Enable UDM support for ACPI-enumerated devices and the
      ACPI bus type.

config UDM_PLATFORM
    bool "Platform Bus Support"
    depends on UDM_CORE
    default y
    help
      Enable support for the Platform Bus, used for non-discoverable
      hardware components.

config UDM_MANAGED_RESOURCES
    bool "Managed Device Resources (devres)"
    depends on UDM_CORE
    default y
    help
      Enable support for managed resources (devm_* API). This allows
      drivers to allocate resources that are automatically freed when
      the driver is detached from the device.

config DEBUG_DRIVER_MODEL
    bool "Driver Model Debugging"
    depends on UDM_CORE
    default n
    help
      Enable verbose logging for device/driver registration,
      binding, and lifecycle events.

config SYS_BUS_DEBUG
    bool "Bus Debugging"
    depends on UDM_CORE
    default n
    help
      Enable specific debugging for bus registration and enumeration.

config UDM_ORCHESTRATION
    bool "Global Lifecycle Orchestration"
    depends on UDM_CORE
    default y
    help
      Enable high-level driver orchestration APIs for system-wide
      driver lifecycle management (suspend_all, resume_all, etc.).

config DEBUG_UDM
    bool "UDM Lifecycle Debugging"
    depends on UDM_ORCHESTRATION
    default n
    help
      Enable verbose logging for UDM operations including
      suspend, resume, stop, and restart events.

config UDM_EMERGENCY_STOP
    bool "UDM Emergency Stop Support"
    depends on UDM_ORCHESTRATION
    default y
    help
      Enable emergency stop functionality for critical system
      failures. This allows immediate driver halt without
      error checking.

config UDM_SUSPEND_TIMEOUT_MS
    int "UDM Suspend Timeout (milliseconds)"
    depends on UDM_ORCHESTRATION
    default 5000
    range 1000 30000
    help
      Maximum time to wait for a driver to suspend before
      considering it failed.

endmenu
```

## arch/Kconfig
```kconfig
# SPDX-License-Identifier: GPL-2.0-only

menu "arch"

config SYMMETRIC_MP
    bool "Enable SMP support"
    default y
    help
      Enables SMP support for the AeroSync kernel subsystems

config MAX_CPUS
    int "Maximum # supported of logical processor(s)"
    default 512

menu "cpu topology"

config RDPID_SUPPORT
    bool "Support RDPID instruction"
    default y
    help
      Enables detection and support for the RDPID instruction, which
      allows fast retrieval of the logical CPU ID.

config RDPID_CPU_ID
    bool "Use RDPID for logical CPU ID"
    depends on RDPID_SUPPORT
    default n
    help
      Use the RDPID instruction to retrieve the logical CPU ID.
      This is faster than reading from the per-CPU area via GS.
      Requires RDPID_SUPPORT and hardware support.

endmenu

endmenu
```

## crypto/Kconfig
```kconfig
# SPDX-License-Identifier: GPL-2.0-only

menu "crypto"

config CRYPTO
	bool "Cryptography API"
	default y
	help
	  This option provides the core Cryptography API for the kernel.

if CRYPTO

config CRYPTO_HASH
	bool "Hash algorithms"
	default y

config CRYPTO_SHA256
	bool "SHA-256"
	depends on CRYPTO_HASH
	default y

config CRYPTO_SHA512
	bool "SHA-512"
	depends on CRYPTO_HASH
	default y

config CRYPTO_SHA1
	bool "SHA-1"
	depends on CRYPTO_HASH
	default y

config CRYPTO_BLAKE2S
	bool "BLAKE2s"
	depends on CRYPTO_HASH
	default y

config CRYPTO_CRC32
	bool "CRC32"
	depends on CRYPTO_HASH
	default y

config CRYPTO_HMAC
	bool "HMAC support"
	depends on CRYPTO_HASH
	default y

config CRYPTO_CIPHER
	bool "Cipher algorithms"
	default y

config CRYPTO_AES
	bool "AES"
	depends on CRYPTO_CIPHER
	default y

config CRYPTO_HW
	bool "Hardware acceleration"
	default y

config CRYPTO_AES_NI
	bool "AES-NI (Intel/AMD)"
	depends on CRYPTO_HW && CRYPTO_AES
	default y

config CRYPTO_SHA_NI
	bool "SHA-NI (Intel/AMD)"
	depends on CRYPTO_HW && CRYPTO_SHA256
	default y

config CRYPTO_RNG
	bool "Random Number Generation"
	default y

config CRYPTO_RDRAND
	bool "Use RDRAND/RDSEED (Intel/AMD)"
	depends on CRYPTO_RNG && CRYPTO_HW
	default y

config CRYPTO_DEV_PATH
	string "Crypto device path"
	depends on CRYPTO
	default "/runtime/devices/crypto"
	help
	  The path where the crypto device node will be created in devtmpfs.

endif # CRYPTO

endmenu
```
